## boards/shields/sofle/Kconfig.defconfig
```kconfig
if SHIELD_SOFLE_LEFT
    config ZMK_KEYBOARD_NAME
        default "Sofle"

    config ZMK_SPLIT_BLE_ROLE_CENTRAL
        default y

endif # LEFT

if SHIELD_SOFLE_LEFT || SHIELD_SOFLE_RIGHT
    config ZMK_SPLIT
        default y
```
